## meta-handbook/conf/layer.conf
```bitbake
BBPATH .= ":${LAYERDIR}"
BBFILES += "${LAYERDIR}/recipes-*/*/*.bb ${LAYERDIR}/recipes-*/*/*.bbappend"
BBFILE_COLLECTIONS += "handbook"
BBFILE_PATTERN_handbook = "^${LAYERDIR}/"
BBFILE_PRIORITY_handbook = "10"
LAYERSERIES_COMPAT_handbook = "scarthgap"
LAYERDEPENDS_handbook = "core rauc"
```
