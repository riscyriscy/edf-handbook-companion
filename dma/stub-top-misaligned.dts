/dts-v1/;
/* A stand-in for the rest of the device tree, so that dtc can compile the fragments on any host.
   The first include is the shared memory of an R5F core (Chapter 18). The second is the DMA pool. */
/ {
	#address-cells = <2>;
	#size-cells = <2>;
	memory@0 {
		device_type = "memory";
		reg = <0x0 0x0 0x0 0x80000000>;
	};
};
/include/ "../rpu/r5-memory.dtsi"
/include/ "pl-dma-memory-misaligned.dtsi"
